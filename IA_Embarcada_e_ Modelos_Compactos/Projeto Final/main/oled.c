#include "oled.h"
#include <stdio.h>
#include <string.h>
#include <stdint.h>
#include "driver/i2c_master.h"

/* FONTE 5x8 /  Fonte ASCII de 32 até 127. */
static const uint8_t font5x8[96][5] = {
    {0x00, 0x00, 0x00, 0x00, 0x00}, {0x00, 0x00, 0x5f, 0x00, 0x00},
    {0x00, 0x07, 0x00, 0x07, 0x00}, {0x14, 0x7f, 0x14, 0x7f, 0x14},
    {0x24, 0x2a, 0x7f, 0x2a, 0x12}, {0x23, 0x13, 0x08, 0x64, 0x62},
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    {0x08, 0x08, 0x2a, 0x1c, 0x08}, {0x08, 0x14, 0x22, 0x41, 0x00}
};

static esp_err_t oled_write(i2c_master_dev_handle_t dev, const uint8_t* dados, size_t tamanho) {
    // Timeout alterado para 100ms. Evita o travamento infinito no Wokwi!
    return i2c_master_transmit(dev, dados, tamanho, 100);
}

static esp_err_t oled_command(i2c_master_dev_handle_t dev, uint8_t comando) {
    uint8_t dados[2] = {0x00, comando};
    return oled_write(dev, dados, sizeof(dados));
}

i2c_master_dev_handle_t oled_init(i2c_master_bus_handle_t bus, uint8_t endereco) {
    if (bus == NULL) return NULL;

    i2c_master_dev_handle_t dev = NULL;
    i2c_device_config_t dev_config = {
        .dev_addr_length = I2C_ADDR_BIT_LEN_7,
        .device_address = endereco,
        .scl_speed_hz = 400000
    };

    if (i2c_master_bus_add_device(bus, &dev_config, &dev) != ESP_OK) return NULL;

    const uint8_t comandos[] = {
        0xAE, 0xD5, 0x80, 0xA8, 0x3F, 0xD3, 0x00, 0x40,
        0x8D, 0x14, 0x20, 0x02, 0x00, 0xA1, 0xC8, 0xDA, 0x12,
        0x81, 0xCF, 0xD9, 0xF1, 0xDB, 0x40, 0xA4, 0xA6, 0xAF
    };

    for (size_t i = 0; i < sizeof(comandos); i++) {
        oled_command(dev, comandos[i]);
    }

    printf("OLED no endereco 0x%02x inicializado!\n", endereco);
    return dev;
}

void oled_clear(i2c_master_dev_handle_t dev) {
    if (dev == NULL) return;

    for (int pagina = 0; pagina < 8; pagina++) {
        uint8_t comandos[] = {
            0x00, (uint8_t)(0xB0 + pagina), 0x00, 0x10
        };
        oled_write(dev, comandos, sizeof(comandos));
        
        // Envia a limpeza em pequenos pacotes de 16 colunas para nao travar o Wokwi
        uint8_t dados[17];
        dados[0] = 0x40; // Indica que sao dados visuais
        memset(&dados[1], 0x00, 16); 
        
        for(int bloco = 0; bloco < 8; bloco++) { // 8 x 16 = 128 colunas
            oled_write(dev, dados, sizeof(dados));
        }
    }
}

void oled_print(i2c_master_dev_handle_t dev, int x, int y, const char* texto) {
    if (dev == NULL || texto == NULL) return;

    if (x < 0) x = 0;
    if (x > 127) x = 127;
    if (y < 0) y = 0;
    if (y > 7) y = 7;

    uint8_t comandos[] = {
        0x00,
        (uint8_t)(0xB0 + y),
        (uint8_t)(0x00 + (x & 0x0F)),
        (uint8_t)(0x10 + ((x >> 4) & 0x0F))
    };
    oled_write(dev, comandos, sizeof(comandos));

    uint8_t dados[129];
    dados[0] = 0x40;
    int indice = 1;
    size_t tamanho = strlen(texto);

    for (size_t i = 0; i < tamanho; i++) {
        int char_idx = texto[i] - 32;
        if (char_idx >= 0 && char_idx < 96) {
            if (indice + 6 > 129) break;
            for (int j = 0; j < 5; j++) {
                dados[indice++] = font5x8[char_idx][j];
            }
            dados[indice++] = 0x00; // Espaçamento entre as letras
            
            // Quebra o texto em pacotinhos menores se for ficar muito grande
            if (indice >= 16) {
                oled_write(dev, dados, indice);
                indice = 1; // Reseta o buffer
            }
        }
    }

    if (indice > 1) {
        oled_write(dev, dados, indice);
    }
}